#ifndef MYIMU_DMP_H_INCLUDED
#define MYIMU_DMP_H_INCLUDED

#include "myMPU6050.h"

#define MPU6050_DMP_CODE_SIZE       1929    // dmpMemory[]
#if UseGyroFiFo==1
    #if UseAcceleroFiFo==1
        #define MPU6050_DMP_CONFIG_SIZE     111+14
        #define JumlahFiFo                  40  //  16+12+12 data   (quaternion + Gyroscope + Accelero)
    #else
        #define MPU6050_DMP_CONFIG_SIZE     111+7
        #define JumlahFiFo                  28  //  16+12 data      (quaternion + Gyroscope)
    #endif // UseAcceleroFiFo
#else
    #if UseAcceleroFiFo==1
        #define MPU6050_DMP_CONFIG_SIZE     111+7
        #define JumlahFiFo                  28  //  16+12 data  (quaternion + accelerometer)
    #else
        #define MPU6050_DMP_CONFIG_SIZE     111
        #define JumlahFiFo                  16  //  16 data     (quaternion)
    #endif // UseAcceleroFiFo
#endif // UseAcceleroFiFo

#define MPU6050_DMP_UPDATES_SIZE    47      // dmpUpdates[]
#define DMP_INIT_DEBUG              0       // menampilkan proses inisialisasi ke LCD

/* ================================================================================================ *
 | 18-byte FIFO packet structure:                                                                   |
 |                                                                                                  |
 | [QUAT W][      ][QUAT X][      ][QUAT Y][      ][QUAT Z][      ][FOOTER]                         |
 |   0   1   2   3   4   5   6   7   8   9  10  11  12  13  14  15  16  17                          |
 |                                                                                                  |
 |                                                                                                  |
 | 30-byte FIFO packet structure:                                                                   |
 |                                                                                                  |
 | [QUAT W][      ][QUAT X][      ][QUAT Y][      ][QUAT Z][      ][Gyro/Accel X  ]                 |
 |   0   1   2   3   4   5   6   7   8   9  10  11  12  13  14  15  16  17  18  19                  |          |
 |  [Gyro/Accel Y  ][Gyro/Accel Z  ][Footer]                                                        |
 |   20  21  22  23  24  25  26  27  88  29                                                         |
 * ================================================================================================ */

// this block of memory gets written to the MPU on start-up, and it seems
// to be volatile memory, so it has to be done each time (it only takes ~1
// second though)
const unsigned char dmpMemory[MPU6050_DMP_CODE_SIZE] PROGMEM = {
    // bank 0, 256 bytes
    0xFB, 0x00, 0x00, 0x3E, 0x00, 0x0B, 0x00, 0x36, 0x00, 0x01, 0x00, 0x02, 0x00, 0x03, 0x00, 0x00,
    0x00, 0x65, 0x00, 0x54, 0xFF, 0xEF, 0x00, 0x00, 0xFA, 0x80, 0x00, 0x0B, 0x12, 0x82, 0x00, 0x01,
    0x00, 0x02, 0x00, 0x00, 0x00, 0x00, 0x00, 0x00, 0x00, 0x00, 0x00, 0x00, 0x00, 0x00, 0x00, 0x00,
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    0xFF, 0xE6, 0x80, 0x79, 0x02, 0x00, 0x00, 0x00, 0x00, 0x00, 0xD0, 0xD6, 0x00, 0x00, 0x27, 0x10,

    // bank 1, 256 bytes
    0xFB, 0x00, 0x00, 0x00, 0x40, 0x00, 0x00, 0x00, 0x00, 0x00, 0x00, 0x00, 0x00, 0x00, 0x00, 0x00,
    0x00, 0x00, 0x00, 0x01, 0x00, 0x00, 0x00, 0x00, 0x00, 0x00, 0x01, 0x00, 0x01, 0x00, 0x00, 0x00,
    0x00, 0x00, 0xFA, 0x36, 0xFF, 0xBC, 0x30, 0x8E, 0x00, 0x05, 0xFB, 0xF0, 0xFF, 0xD9, 0x5B, 0xC8,
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    0x00, 0x00, 0x25, 0x4D, 0x00, 0x2F, 0x70, 0x6D, 0x00, 0x00, 0x05, 0xAE, 0x00, 0x0C, 0x02, 0xD0,

    // bank 2, 256 bytes
    0x00, 0x00, 0x00, 0x00, 0x00, 0x65, 0x00, 0x54, 0xFF, 0xEF, 0x00, 0x00, 0x00, 0x00, 0x00, 0x00,
    0x00, 0x00, 0x01, 0x00, 0x00, 0x44, 0x00, 0x00, 0x00, 0x00, 0x0C, 0x00, 0x00, 0x00, 0x01, 0x00,
    0x00, 0x00, 0x00, 0x00, 0x00, 0x65, 0x00, 0x00, 0x00, 0x54, 0x00, 0x00, 0xFF, 0xEF, 0x00, 0x00,
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    0x00, 0x00, 0x00, 0x00, 0x00, 0x00, 0x00, 0x00, 0x00, 0x00, 0x00, 0x00, 0x00, 0x00, 0x00, 0x00,

    // bank 3, 256 bytes
    0xD8, 0xDC, 0xBA, 0xA2, 0xF1, 0xDE, 0xB2, 0xB8, 0xB4, 0xA8, 0x81, 0x91, 0xF7, 0x4A, 0x90, 0x7F,
    0x91, 0x6A, 0xF3, 0xF9, 0xDB, 0xA8, 0xF9, 0xB0, 0xBA, 0xA0, 0x80, 0xF2, 0xCE, 0x81, 0xF3, 0xC2,
    0xF1, 0xC1, 0xF2, 0xC3, 0xF3, 0xCC, 0xA2, 0xB2, 0x80, 0xF1, 0xC6, 0xD8, 0x80, 0xBA, 0xA7, 0xDF,
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    0xB8, 0xA2, 0xDF, 0xDF, 0xDF, 0xA3, 0xDF, 0xDF, 0xDF, 0xD8, 0xD8, 0xF1, 0xB8, 0xA8, 0xB2, 0x86,

    // bank 4, 256 bytes
    0xB4, 0x98, 0x0D, 0x35, 0x5D, 0xB8, 0xAA, 0x98, 0xB0, 0x87, 0x2D, 0x35, 0x3D, 0xB2, 0xB6, 0xBA,
    0xAF, 0x8C, 0x96, 0x19, 0x8F, 0x9F, 0xA7, 0x0E, 0x16, 0x1E, 0xB4, 0x9A, 0xB8, 0xAA, 0x87, 0x2C,
    0x54, 0x7C, 0xB9, 0xA3, 0xDE, 0xDF, 0xDF, 0xA3, 0xB1, 0x80, 0xF2, 0xC4, 0xCD, 0xC9, 0xF1, 0xB8,
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    0xC8, 0x9F, 0x12, 0x9E, 0xF3, 0x15, 0xA8, 0xDA, 0x12, 0x10, 0xD8, 0xF1, 0xAF, 0xC8, 0x97, 0x87,

    // bank 5, 256 bytes
    0x34, 0xB5, 0xB9, 0x94, 0xA4, 0x21, 0xF3, 0xD9, 0x22, 0xD8, 0xF2, 0x2D, 0xF3, 0xD9, 0x2A, 0xD8,
    0xF2, 0x35, 0xF3, 0xD9, 0x32, 0xD8, 0x81, 0xA4, 0x60, 0x60, 0x61, 0xD9, 0x61, 0xD8, 0x6C, 0x68,
    0x69, 0xD9, 0x69, 0xD8, 0x74, 0x70, 0x71, 0xD9, 0x71, 0xD8, 0xB1, 0xA3, 0x84, 0x19, 0x3D, 0x5D,
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    0x8A, 0x64, 0x48, 0x31, 0x8B, 0x30, 0x49, 0x60, 0xA5, 0x88, 0x20, 0x09, 0x71, 0x58, 0x44, 0x68,

    // bank 6, 256 bytes
    0x11, 0x39, 0x64, 0x49, 0x30, 0x19, 0xF1, 0xAC, 0x00, 0x2C, 0x54, 0x7C, 0xF0, 0x8C, 0xA8, 0x04,
    0x28, 0x50, 0x78, 0xF1, 0x88, 0x97, 0x26, 0xA8, 0x59, 0x98, 0xAC, 0x8C, 0x02, 0x26, 0x46, 0x66,
    0xF0, 0x89, 0x9C, 0xA8, 0x29, 0x51, 0x79, 0x24, 0x70, 0x59, 0x44, 0x69, 0x38, 0x64, 0x48, 0x31,
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    0xAC, 0x91, 0x2C, 0x4C, 0x6C, 0x8A, 0x9B, 0x2D, 0xD9, 0xD8, 0xD8, 0x51, 0xD9, 0xD8, 0xD8, 0x79,

    // bank 7, 138 bytes (remainder)
    0xD9, 0xD8, 0xD8, 0xF1, 0x9E, 0x88, 0xA3, 0x31, 0xDA, 0xD8, 0xD8, 0x91, 0x2D, 0xD9, 0x28, 0xD8,
    0x4D, 0xD9, 0x48, 0xD8, 0x6D, 0xD9, 0x68, 0xD8, 0xB1, 0x83, 0x93, 0x35, 0x3D, 0x80, 0x25, 0xDA,
    0xD8, 0xD8, 0x85, 0x69, 0xDA, 0xD8, 0xD8, 0xB4, 0x93, 0x81, 0xA3, 0x28, 0x34, 0x3C, 0xF3, 0xAB,
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    0xB9, 0xA7, 0xF1, 0x26, 0x26, 0x26, 0xD8, 0xD8, 0xFF
};

// thanks to Noah Zerkin for piecing this stuff together!
const unsigned char dmpConfig[MPU6050_DMP_CONFIG_SIZE] PROGMEM = {
//  BANK    OFFSET  LENGTH  [DATA]
    0x03,   0x7B,   0x03,   0x4C, 0xCD, 0x6C,               // FCFG_1 inv_set_gyro_calibration
    0x03,   0xAB,   0x03,   0x36, 0x56, 0x76,               // FCFG_3 inv_set_gyro_calibration
    0x00,   0x68,   0x04,   0x02, 0xCB, 0x47, 0xA2,         // D_0_104 inv_set_gyro_calibration
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    0x00,   0x6C,   0x02,   0x20, 0x00,                     // D_0_108 inv_set_accel_calibration
    //0x02,   0x40,   0x04,   0x00, 0x00, 0x00, 0x00,       // CPASS_MTX_00 inv_set_compass_calibration
    //0x02,   0x44,   0x04,   0x00, 0x00, 0x00, 0x00,       // CPASS_MTX_01
    //0x02,   0x48,   0x04,   0x00, 0x00, 0x00, 0x00,       // CPASS_MTX_02
    //0x02,   0x4C,   0x04,   0x00, 0x00, 0x00, 0x00,       // CPASS_MTX_10
    //0x02,   0x50,   0x04,   0x00, 0x00, 0x00, 0x00,       // CPASS_MTX_11
    //0x02,   0x54,   0x04,   0x00, 0x00, 0x00, 0x00,       // CPASS_MTX_12
    //0x02,   0x58,   0x04,   0x00, 0x00, 0x00, 0x00,       // CPASS_MTX_20
    //0x02,   0x5C,   0x04,   0x00, 0x00, 0x00, 0x00,       // CPASS_MTX_21
    //0x02,   0xBC,   0x04,   0x00, 0x00, 0x00, 0x00,       // CPASS_MTX_22
    0x01,   0xEC,   0x04,   0x00, 0x00, 0x40, 0x00,         // D_1_236 inv_apply_endian_accel
    0x03,   0x7F,   0x06,   0x0C, 0xC9, 0x2C, 0x97, 0x97, 0x97, // FCFG_2 inv_set_mpu_sensors
    0x04,   0x02,   0x03,   0x0D, 0x35, 0x5D,               // CFG_MOTION_BIAS inv_turn_on_bias_from_no_motion
    //0x04,   0x02,   0x03,   0x98, 0x98, 0x98,             // CFG_MOTION_BIAS inv_turn_off bias correction
    0x04,   0x09,   0x04,   0x87, 0x2D, 0x35, 0x3D,         // FCFG_5 inv_set_bias_update
    0x00,   0xA3,   0x01,   0x00,                           // D_0_163 inv_set_dead_zone
                 // SPECIAL 0x01 = enable interrupts
    0x00,   0x00,   0x00,   0x01, // SET INT_ENABLE at i=22, SPECIAL INSTRUCTION
    0x07,   0x86,   0x01,   0xFE,                           // CFG_6 inv_set_fifo_interupt
    0x07,   0x41,   0x05,   0xF1, 0x20, 0x28, 0x30, 0x38,   // CFG_8 inv_send_quaternion
    //0x07,   0x7E,   0x01,   0x30,                           // CFG_16 inv_set_footer
    0x07,   0x46,   0x01,   0x9A,                         // CFG_GYRO_SOURCE inv_send_gyro
    #if UseGyroFiFo==1
    0x07,   0x47,   0x04,   0xF1, 0x28, 0x30, 0x38,       // CFG_9 inv_send_gyro -> inv_construct3_fifo
    #endif // UseGyroFiFo
    #if UseAcceleroFiFo==1
    0x07,   0x6C,   0x04,   0xF1, 0x28, 0x30, 0x38,       // CFG_12 inv_send_accel -> inv_construct3_fifo
    #endif // UseAcceleroFiFo
    0x02,   0x16,   0x02,   0x00, 0x00                      // D_0_22 inv_set_fifo_rate // Original 0x01
    // DMP output frequency is calculated easily using this equation: (200Hz / (1 + value))
    // It is important to make sure the host processor can keep up with reading and processing
    // the FIFO output at the desired rate. Handling FIFO overflow cleanly is also a good idea.
};

const unsigned char dmpUpdates[MPU6050_DMP_UPDATES_SIZE] PROGMEM = {
    0x01,   0xB2,   0x02,   0xFF, 0xFF,
    0x01,   0x90,   0x04,   0x09, 0x23, 0xA1, 0x35,
    0x01,   0x6A,   0x02,   0x06, 0x00,
    0x01,   0x60,   0x08,   0x00, 0x00, 0x00, 0x00, 0x00, 0x00, 0x00, 0x00,
    0x00,   0x60,   0x04,   0x40, 0x00, 0x00, 0x00,
    0x01,   0x62,   0x02,   0x00, 0x00,
    0x00,   0x60,   0x04,   0x00, 0x40, 0x00, 0x00
};

struct Quaternion
{   float   w,x,y,z;
};

class myDMP:public MPU6050
{   public:
        void    Start()     { myFlag.ImuStart = true; };
        void    Stop()      { myFlag.ImuStart = false; };
        uint8_t Init (void);
        uint8_t InitDMP (void);
        float   getRoll();
        float   getPitch();
        float   getYaw();
        void    dmpGetQuaternion16Bit();
        void    dmpGetQuaternion32Bit();


        uint8_t FifoBuffer[JumlahFiFo+2];     // lihat definisi di bagian atas
        #if UseGyroFiFo==1
        void    dmpGetGyroData();
        int16_t Gx, Gy, Gz;
        #endif // UseGyroFiFo

        #if UseAcceleroFiFo
        void    dmpGetAcceleroData();
        int16_t Ax, Ay, Az;
        #endif // UseGyroFiFo
        //uint8_t dmpPacketSize;
        Quaternion  q;
private:
        float   DoubleInvMag2;
}imu;


void    myDMP::dmpGetQuaternion16Bit()
{   Data16Bit x;
    x.d8u[1] = FifoBuffer[0];        x.d8u[0] = FifoBuffer[1];
    q.w = (float)x.d16s * 0.00006103515625F;
    x.d8u[1] = FifoBuffer[4];        x.d8u[0] = FifoBuffer[5];
    q.x = (float)x.d16s * 0.00006103515625F;
    x.d8u[1] = FifoBuffer[8];        x.d8u[0] = FifoBuffer[9];
    q.y = (float)x.d16s * 0.00006103515625F;
    x.d8u[1] = FifoBuffer[12];       x.d8u[0] = FifoBuffer[13];
    q.z = (float)x.d16s * 0.00006103515625F;
    DoubleInvMag2 = 2.0F / (q.w*q.w + q.x*q.x + q.y*q.y + q.z*q.z);
}

void    myDMP::dmpGetQuaternion32Bit()
{   Data32Bit x;
    x.d8u[3] = FifoBuffer[0];        x.d8u[2] = FifoBuffer[1];
    x.d8u[1] = FifoBuffer[2];        x.d8u[0] = FifoBuffer[3];
    q.w = (float)x.d32s * 0.000000000931322574615478515625F;
    x.d8u[3] = FifoBuffer[4];        x.d8u[2] = FifoBuffer[5];
    x.d8u[1] = FifoBuffer[6];        x.d8u[0] = FifoBuffer[7];
    q.x = (float)x.d32s * 0.000000000931322574615478515625F;
    x.d8u[3] = FifoBuffer[8];        x.d8u[2] = FifoBuffer[9];
    x.d8u[1] = FifoBuffer[10];       x.d8u[0] = FifoBuffer[11];
    q.y = (float)x.d32s * 0.000000000931322574615478515625F;
    x.d8u[3] = FifoBuffer[12];       x.d8u[2] = FifoBuffer[13];
    x.d8u[1] = FifoBuffer[14];       x.d8u[0] = FifoBuffer[15];
    q.z = (float)x.d32s * 0.000000000931322574615478515625F;
    DoubleInvMag2 = 2.0F / (q.w*q.w + q.x*q.x + q.y*q.y + q.z*q.z);
}

#if UseGyroFiFo==1
void    myDMP::dmpGetGyroData()
{   Data16Bit   x;
    //x.d8u[3] = FifoBuffer[16];       x.d8u[2] = FifoBuffer[17];     x.d8u[1] = FifoBuffer[18];       x.d8u[0] = FifoBuffer[19];
    x.d8u[1] = FifoBuffer[16];       x.d8u[0] = FifoBuffer[17];
    Gx = x.d16s;
    //x.d8u[3] = FifoBuffer[20];       x.d8u[2] = FifoBuffer[21];     x.d8u[1] = FifoBuffer[22];       x.d8u[0] = FifoBuffer[23];
    x.d8u[1] = FifoBuffer[20];       x.d8u[0] = FifoBuffer[21];
    Gy = x.d16s;
    //x.d8u[3] = FifoBuffer[24];       x.d8u[2] = FifoBuffer[25];     x.d8u[1] = FifoBuffer[26];       x.d8u[0] = FifoBuffer[27];
    x.d8u[1] = FifoBuffer[24];       x.d8u[0] = FifoBuffer[25];
    Gz = x.d16s;
}
#endif // UseGyroFiFo

#if UseAcceleroFiFo == 1
void    myDMP::dmpGetAcceleroData()
{   Data16Bit   x;
    #if UseGyroFiFo==1
    //x.d8u[3] = FifoBuffer[28];       x.d8u[2] = FifoBuffer[29];     x.d8u[1] = FifoBuffer[30];       x.d8u[0] = FifoBuffer[31];
    x.d8u[1] = FifoBuffer[28];       x.d8u[0] = FifoBuffer[29];
    Ax = x.d16s;
    //x.d8u[3] = FifoBuffer[32];       x.d8u[2] = FifoBuffer[33];     x.d8u[1] = FifoBuffer[34];       x.d8u[0] = FifoBuffer[35];
    x.d8u[1] = FifoBuffer[32];       x.d8u[0] = FifoBuffer[33];
    Ay = x.d16s;
    //x.d8u[3] = FifoBuffer[36];       x.d8u[2] = FifoBuffer[37];     x.d8u[1] = FifoBuffer[38];       x.d8u[0] = FifoBuffer[39];
    x.d8u[1] = FifoBuffer[36];       x.d8u[0] = FifoBuffer[37];
    Az = x.d16s;
    #else
    //x.d8u[3] = FifoBuffer[16];       x.d8u[2] = FifoBuffer[17];     x.d8u[1] = FifoBuffer[18];       x.d8u[0] = FifoBuffer[19];
    x.d8u[1] = FifoBuffer[16];       x.d8u[0] = FifoBuffer[17];
    Ax = x.d16s;
    //x.d8u[3] = FifoBuffer[20];       x.d8u[2] = FifoBuffer[21];     x.d8u[1] = FifoBuffer[22];       x.d8u[0] = FifoBuffer[23];
    x.d8u[1] = FifoBuffer[20];       x.d8u[0] = FifoBuffer[21];
    Ay = x.d16s;
    //x.d8u[3] = FifoBuffer[24];       x.d8u[2] = FifoBuffer[25];     x.d8u[1] = FifoBuffer[26];       x.d8u[0] = FifoBuffer[27];
    x.d8u[1] = FifoBuffer[24];       x.d8u[0] = FifoBuffer[25];
    Az = x.d16s;
    #endif // UseGyroFiFo
}
#endif // UseGyroFiFo


float   myDMP::getRoll()
{   return atan2(DoubleInvMag2*(q.y*q.z + q.w*q.x) , 1 - DoubleInvMag2*(q.w*q.w + q.z*q.z));  // phi
}

float   myDMP::getPitch()
{   //return  asin(DoubleInvMag2*(q.x*q.z - q.w*q.y));      // board tidur
    //return atan2(DoubleInvMag2*(q.w*q.y + q.x*q.z) , DoubleInvMag2*(-q.w*q.w + q.x*q.x + q.y*q.y - q.z*q.z)*0.5);  // phi
    return atan2(DoubleInvMag2*(q.w*q.y - q.x*q.z) , DoubleInvMag2*(-q.w*q.w + q.x*q.x + q.y*q.y - q.z*q.z)*0.5);  // phi
}

float   myDMP::getYaw()
{   float Yaw = atan2(DoubleInvMag2*(q.x*q.y - q.w*q.z) , 1 - DoubleInvMag2*(q.w*q.w + q.x*q.x));  // psi
    if  (Yaw<0) return  Yaw + DualPhi;
    else        return  Yaw;
}

uint8_t    myDMP::Init()
{   if(testConnection())
    {   initialize();
        return InitDMP();
    }
    else
    {   return false;
    }
}

uint8_t myDMP::InitDMP (void)
{
    reset();
    #if DMP_INIT_DEBUG==1
    lcd.HapusBaris(1);  lcd.Tulis(1, ">Reset MPU6050 <");
    #endif // DMP_INIT_DEBUG
    _delay_ms(30); // wait after reset

    setSleepEnabled(false);

    setMemoryBank(0x10, true, true);

    setMemoryStartAddress(0x06);
    //uint8_t hwRevision = readMemoryByte();
    setMemoryBank(0, false, false);

//    uint8_t otpValid = getOTPBankValid();

    setSlaveAddress(0, 0x7F);
    setI2CMasterModeEnabled(false);
    setSlaveAddress(0, 0x68);
    resetI2CMaster();
    _delay_ms(20);
if (writeProgMemoryBlock(dmpMemory, MPU6050_DMP_CODE_SIZE)) {
        #if DMP_INIT_DEBUG==1   //            0123456789012345
        lcd.HapusBaris(1);  lcd.TulisKiri(1, ">> DMP Memori OK");
        #endif // DMP_INIT_DEBUG

        if (writeProgDMPConfigurationSet(dmpConfig, MPU6050_DMP_CONFIG_SIZE)) {
            #if DMP_INIT_DEBUG==1   //            0123456789012345
            lcd.HapusBaris(1);  lcd.TulisKiri(1, ">> DMP Config OK");
            #endif // DMP_INIT_DEBUG

            setClockSource(MPU6050_CLOCK_PLL_ZGYRO);
            setIntEnabled(0x12);
            setRate(4); // 1khz / (1 + 4) = 200 Hz

            setExternalFrameSync(MPU6050_EXT_SYNC_TEMP_OUT_L);

            setDLPFMode(MPU6050_DLPF_BW_42);

            setFullScaleGyroRange(MPU6050_GYRO_FS_2000);

            setDMPConfig1(0x03);
            setDMPConfig2(0x00);

            setOTPBankValid(false);

            uint8_t dmpUpdate[16], j;
            uint16_t pos = 0;
            #if DMP_INIT_DEBUG==1   //            0123456789012345
            lcd.HapusBaris(1);  lcd.TulisKiri(1, "1.Tulis Bank 1/7");
            #endif // DMP_INIT_DEBUG
            for (j = 0; j < 4 || j < dmpUpdate[2] + 3; j++, pos++) dmpUpdate[j] = pgm_read_byte(&dmpUpdates[pos]);
            writeMemoryBlock(dmpUpdate + 3, dmpUpdate[2], dmpUpdate[0], dmpUpdate[1]);

            //DEBUG_PRINTLN(F("Writing final memory update 2/7 (function unknown)..."));
            #if DMP_INIT_DEBUG==1   //            0123456789012345
            lcd.HapusBaris(1);  lcd.TulisKiri(1, "2.Tulis Bank 2/7");
            #endif // DMP_INIT_DEBUG
            for (j = 0; j < 4 || j < dmpUpdate[2] + 3; j++, pos++) dmpUpdate[j] = pgm_read_byte(&dmpUpdates[pos]);
            writeMemoryBlock(dmpUpdate + 3, dmpUpdate[2], dmpUpdate[0], dmpUpdate[1]);

            resetFIFO();

            uint16_t fifoCount = getFIFOCount();

            setMotionDetectionThreshold(2);
            setZeroMotionDetectionThreshold(156);
            setMotionDetectionDuration(80);
            setZeroMotionDetectionDuration(0);

            resetFIFO();

            setFIFOEnabled(true);

            setDMPEnabled(true);

            resetDMP();

            #if DMP_INIT_DEBUG==1   //            0123456789012345
            lcd.HapusBaris(1);  lcd.TulisKiri(1, "3.Tulis Bank 3/7");
            #endif // DMP_INIT_DEBUG
            for (j = 0; j < 4 || j < dmpUpdate[2] + 3; j++, pos++) dmpUpdate[j] = pgm_read_byte(&dmpUpdates[pos]);
            writeMemoryBlock(dmpUpdate + 3, dmpUpdate[2], dmpUpdate[0], dmpUpdate[1]);

            #if DMP_INIT_DEBUG==1   //            0123456789012345
            lcd.HapusBaris(1);  lcd.TulisKiri(1, "4.Tulis Bank 4/7");
            #endif // DMP_INIT_DEBUG
            for (j = 0; j < 4 || j < dmpUpdate[2] + 3; j++, pos++) dmpUpdate[j] = pgm_read_byte(&dmpUpdates[pos]);
            writeMemoryBlock(dmpUpdate + 3, dmpUpdate[2], dmpUpdate[0], dmpUpdate[1]);

            #if DMP_INIT_DEBUG==1   //            0123456789012345
            lcd.HapusBaris(1);  lcd.TulisKiri(1, "5.Tulis Bank 5/7");
            #endif // DMP_INIT_DEBUG
            for (j = 0; j < 4 || j < dmpUpdate[2] + 3; j++, pos++) dmpUpdate[j] = pgm_read_byte(&dmpUpdates[pos]);
            writeMemoryBlock(dmpUpdate + 3, dmpUpdate[2], dmpUpdate[0], dmpUpdate[1]);

            while ((fifoCount = getFIFOCount()) < 3);

            #if DMP_INIT_DEBUG==1   //            0123456789012345
            lcd.HapusBaris(1);  lcd.TulisKiri(1, "6.Tulis Bank 6/7");
            #endif // DMP_INIT_DEBUG
            for (j = 0; j < 4 || j < dmpUpdate[2] + 3; j++, pos++) dmpUpdate[j] = pgm_read_byte(&dmpUpdates[pos]);
            readMemoryBlock(dmpUpdate + 3, dmpUpdate[2], dmpUpdate[0], dmpUpdate[1]);

            while ((fifoCount = getFIFOCount()) < 3);

            #if DMP_INIT_DEBUG==1   //            0123456789012345
            lcd.HapusBaris(1);  lcd.TulisKiri(1, "7.Tulis Bank 7/7");
            #endif // DMP_INIT_DEBUG
            for (j = 0; j < 4 || j < dmpUpdate[2] + 3; j++, pos++) dmpUpdate[j] = pgm_read_byte(&dmpUpdates[pos]);
            writeMemoryBlock(dmpUpdate + 3, dmpUpdate[2], dmpUpdate[0], dmpUpdate[1]);

            setDMPEnabled(false);
            resetFIFO();
            //getIntStatus();
        } else {
            //ERROR! DMP configuration verification failed
            return false; // configuration block loading failed
        }
    } else {
        //ERROR! DMP code verification failed.
        return false; // main binary block loading failed
    }
    //                                    0123456789012345
    lcd.HapusBaris(1);  lcd.TulisKiri(1, "Init DMP Selesai");
    return true; // success
}




#endif // MYIMU_DMP_H_INCLUDED
